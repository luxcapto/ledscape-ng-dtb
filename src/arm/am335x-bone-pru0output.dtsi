/*
 * Copyright (C) 2016 Nash Kaminski
 *
 * This program is free software; you can redistribute it and/or modify
 * it under the terms of the GNU General Public License version 2 as
 * published by the Free Software Foundation.
 */

#include <dt-bindings/board/am335x-bbw-bbb-base.h>

/* on chip peripheral declaration */

 &ocp {
 	PRU0_output: ocp_pru0_output {
		compatible = "bone-pinmux-helper";
		pinctrl-names = "default";
		status = "okay";
		pinctrl-0 = <&pru0_pins>;
	};	
 };

/* pinmux */

&am33xx_pinmux {
	pru0_pins: pinmux_pru0_pins {
		pinctrl-single,pins = <
            /* PRU0 r30 pins */
			BONE_P9_31 (PIN_OUTPUT | MUX_MODE5 | SLEWCTRL_SLOW)
			BONE_P9_29 (PIN_OUTPUT | MUX_MODE5 | SLEWCTRL_SLOW)
			BONE_P9_30 (PIN_OUTPUT | MUX_MODE5 | SLEWCTRL_SLOW)
			BONE_P9_28 (PIN_OUTPUT | MUX_MODE5 | SLEWCTRL_SLOW)
			BONE_P9_27 (PIN_OUTPUT | MUX_MODE5 | SLEWCTRL_SLOW)
   			/* Never set P9_42A and P9_42B as output! Hardware may be damaged! */
			BONE_P9_42A (PIN_INPUT | MUX_MODE7)
			BONE_P9_42B (PIN_OUTPUT | MUX_MODE5 | SLEWCTRL_SLOW)

            /* PRU1 r30 pins */
            BONE_P8_41 (PIN_OUTPUT | MUX_MODE5 | SLEWCTRL_SLOW)
            BONE_P8_42 (PIN_OUTPUT | MUX_MODE5 | SLEWCTRL_SLOW)
            BONE_P8_43 (PIN_OUTPUT | MUX_MODE5 | SLEWCTRL_SLOW)
            BONE_P8_44 (PIN_OUTPUT | MUX_MODE5 | SLEWCTRL_SLOW)
            BONE_P8_45 (PIN_OUTPUT | MUX_MODE5 | SLEWCTRL_SLOW)
            BONE_P8_46 (PIN_OUTPUT | MUX_MODE5 | SLEWCTRL_SLOW)
            
            /* GP OUTPUT PINS */
            BONE_P9_14 (PIN_OUTPUT | MUX_MODE7 | SLEWCTRL_SLOW)
            BONE_P9_16 (PIN_OUTPUT | MUX_MODE7 | SLEWCTRL_SLOW)
		>;
	};
};
